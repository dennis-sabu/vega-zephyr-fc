## zephyr/module/drivers/Kconfig
```kconfig
rsource "i2c/Kconfig"
rsource "spi/Kconfig"
rsource "pwm/Kconfig"
rsource "adc/Kconfig"
```

## zephyr/module/drivers/adc/Kconfig
```kconfig
# Not part of upstream Zephyr. See zephyr/module/CMakeLists.txt.

config ADC_THEJAS32
	bool "C-DAC THEJAS32 ADC driver"
	default y
	depends on DT_HAS_CDAC_THEJAS32_ADC_ENABLED
	select ADC
	help
	  Out-of-tree ADC driver for the C-DAC THEJAS32 SoC's 4-channel ADC
	  block (ARIES v3.0 board). Not part of upstream Zephyr.

	  Verified from only ONE source (the native VEGA SDK's
	  bsp/drivers/adc/adc.c) rather than two independently-agreeing
	  sources like the I2C/SPI/PWM drivers in this same module -- the
	  Arduino core has no usable ADC source to cross-check against.
	  Resolution and reference voltage are not documented anywhere this
	  project could read; this driver returns the raw register value
	  masked to the requested sequence->resolution bit width without
	  claiming that width is the hardware's actual native resolution.

config ADC_THEJAS32_TIMEOUT_US
	int "Conversion-wait timeout in microseconds"
	default 10000
	depends on ADC_THEJAS32
	help
	  Upper bound on the conversion-ready spin-wait. The native SDK's
	  own adc.c uses an unbounded while() loop for the same wait.
```

## zephyr/module/drivers/i2c/Kconfig
```kconfig
# Not part of upstream Zephyr. See zephyr/module/CMakeLists.txt.

config I2C_THEJAS32
	bool "C-DAC THEJAS32 I2C driver"
	default y
	depends on DT_HAS_CDAC_THEJAS32_I2C_ENABLED
	select I2C
	help
	  Out-of-tree polling-mode I2C driver for the C-DAC THEJAS32 SoC
	  (ARIES v3.0 board). Not part of upstream Zephyr -- see
	  zephyr/module/CMakeLists.txt in this repository for why, and for
	  the two independent sources every register/bit value here is
	  checked against.

	  Hardware read transactions are capped at 16 bytes; a larger
	  i2c_msg read request is rejected with -EINVAL rather than split
	  transparently, since this project did not verify that splitting a
	  single logical read into two hardware transactions (each with its
	  own START/address/STOP) is safe for an arbitrary target device's
	  register-read semantics.

config I2C_THEJAS32_TIMEOUT_US
	int "Bus-wait timeout in microseconds"
	default 10000
	depends on I2C_THEJAS32
	help
	  Upper bound on every register-status spin-wait in this driver
	  (start/stop acknowledgement, TX FIFO state, RX ready). The native
	  SDK driver this is modeled on uses unbounded while() loops for the
	  same waits, which can hang forever on a stuck bus (e.g. SDA held
	  low, missing pull-ups) -- this Kconfig option is what lets this
	  driver return -ETIMEDOUT instead.
```

## zephyr/module/drivers/pwm/Kconfig
```kconfig
# Not part of upstream Zephyr. See zephyr/module/CMakeLists.txt.

config PWM_THEJAS32
	bool "C-DAC THEJAS32 PWM driver"
	default y
	depends on DT_HAS_CDAC_THEJAS32_PWM_ENABLED
	select PWM
	help
	  Out-of-tree PWM driver for the C-DAC THEJAS32 SoC's 8-channel PWM
	  block (ARIES v3.0 board). Not part of upstream Zephyr.

	  The hardware's period/duty registers are raw timer counts, not a
	  frequency+duty-cycle pair -- this driver converts Zephyr's
	  pwm_set_cycles() nanosecond-based period/pulse into those counts
	  using the CPU clock-frequency devicetree property, since no
	  separate PWM clock divider was found documented for this block in
	  either source this project could read (see the driver's top
	  comment for exactly what WAS cross-verified).
```

## zephyr/module/drivers/spi/Kconfig
```kconfig
# Not part of upstream Zephyr. See zephyr/module/CMakeLists.txt.

config SPI_THEJAS32
	bool "C-DAC THEJAS32 SPI driver"
	default y
	depends on DT_HAS_CDAC_THEJAS32_SPI_ENABLED
	select SPI
	help
	  Out-of-tree polling-mode SPI driver for the C-DAC THEJAS32 SoC
	  (ARIES v3.0 board). Not part of upstream Zephyr. 8-bit words only
	  (the hardware's Dbits field is wider, but this driver only
	  implements the 8-bit case the native SDK itself defaults to and
	  that this project could cross-verify against two sources).

config SPI_THEJAS32_TIMEOUT_US
	int "Bus-wait timeout in microseconds"
	default 10000
	depends on SPI_THEJAS32
	help
	  Upper bound on the busy/TX-empty/RX-complete spin-waits in this
	  driver. The native SDK's own spi.c uses unbounded while() loops
	  for the same waits.
```
